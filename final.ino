#include<Wire.h>
#include<SoftwareSerial.h>
#include <Arduino.h>
#include "Talkie.h"

const int8_t Vo_Call[] PROGMEM = {
  0xa0, 0xaa, 0xb8, 0xa8, 0xd4, 0x42, 0xae, 0x0, 0x4a, 0xb, 0x5f, 0x7a,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 0x1,
};

const int8_t Vo_Gas[] PROGMEM = {
  0x0, 0xd, 0x4f, 0x4e, 0x33, 0x52, 0xe3, 0x1c, 0x32, 0xbb, 0xc8, 0x2c,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 0x1e,
};

const int8_t Vo_Impulse[] PROGMEM = { 
  0xa0, 0xe8, 0x22, 0x9b, 0x8d, 0xcb, 0x29, 0x2, 0x1a, 0x33, 0x2d, 0x64,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 0x78, 
};

const int8_t Vo_Helmet[] PROGMEM {
  0xce, 0x88, 0x36, 0x8c, 0x9d, 0x93, 0x1e, 0xab, 0x6, 0xf, 0x71, 0x8c,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 0x78, 
};

Talkie voice;
 

SoftwareSerial BTSerial(10,11);

byte buffer[1024];
int bufferPosition;

const int MPU_addr=0x68;  // I2C address of the MPU-6050
int16_t AcX,AcY,AcZ;
int red = 7;
int green = 12;
int blue = 13;
 long acx = abs(AcX);
  long acy = abs(AcY);
  long acz = abs(AcZ);
  long impulse = acx + acy + acz;
void setup(){ 
  
  delay(3000);
  Serial.begin(9600);
  bufferPosition = 0;
  BTSerial.begin(9600);
  pinMode(red, OUTPUT);
  pinMode(green, OUTPUT);
  pinMode(blue, OUTPUT);
  Wire.begin();
  Wire.beginTransmission(MPU_addr);
  Wire.write(0x6B);  // PWR_MGMT_1 register
  Wire.write(0);     // set to zero (wakes up the MPU-6050)
  Wire.endTransmission(true);
}

void loop(){
  int gas = analogRead(A1);;
  int light = analogRead(A0);
  int touch = digitalRead(5);

 if(light > 700) {
  analogWrite(red, 255);
  analogWrite(green, 255);
  analogWrite(blue, 255);
  }

  if(light <= 700) {
  analogWrite(red, 0);
  analogWrite(green, 0);
  analogWrite(blue, 0);
  }
   if(gas > 600) {

  }
   
 
  

//  if(BTSerial.available()) {
//    if(BTSerial.read() == '1') {
//      analogWrite(red, 255);
//    }
//  }

  
  Wire.beginTransmission(MPU_addr);
  Wire.write(0x3B);  // starting with register 0x3B (ACCEL_XOUT_H)
  Wire.endTransmission(false);
  Wire.requestFrom(MPU_addr,14,true);  // request a total of 14 registers
  AcX = Wire.read()<<8|Wire.read();  // 0x3B (ACCEL_XOUT_H) & 0x3C (ACCEL_XOUT_L)    
  AcY = Wire.read()<<8|Wire.read();  // 0x3D (ACCEL_YOUT_H) & 0x3E (ACCEL_YOUT_L)
  AcZ = Wire.read()<<8|Wire.read();  // 0x3F (ACCEL_ZOUT_H) & 0x40 (ACCEL_ZOUT_L)
  long acx = abs(AcX);
  long acy = abs(AcY);
  long acz = abs(AcZ);
  long impulse = acx + acy + acz;

  Serial.print("AcX = "); Serial.print(acx);
  Serial.print(" | AcY = "); Serial.print(acy);
  Serial.print(" | AcZ = "); Serial.println(acz);
  Serial.print("light = ");
  Serial.println(light);
  Serial.print("gas = ");
  Serial.println(gas);
  Serial.print("touch = ");
  Serial.println(touch);
  Serial.print("impulse = ");
  Serial.println(impulse);
  

  BTSerial.print(light);
  BTSerial.print(",");
  BTSerial.print(gas);
  BTSerial.print(",");
  BTSerial.print(1);
  BTSerial.print(",");
  BTSerial.print(impulse);
  BTSerial.print(",");
  BTSerial.println();

  if(impulse > 35000) {
  }

  
int text = BTSerial.read();
  switch(text)
  {
    case 'A':
    voice.say(Vo_Call);
    break;
    
    case 'B':
    voice.say(Vo_Helmet);
    break;
  }
  
  Serial.println();
 delay(3000);
}
